## linux/Documentation/devicetree/bindings/fb/socionext-fb.txt
```
* Socionext Framebuffer

Socionext IRIS is a kind of display engine.

Required properties:
- compatible : Should be "socionext,f-iris-fb"
- reg : Address and length of the register memory map.
- interrupts : irq number for this device.
- id : Identification number.
- simple : Define to use simple framebuffer or fdb-drm.
	   <0> for fdb-drm, and nonzero for simple linux framebuffer.
	   (fdb: Socionext Display Bus)
- clocks : Refer Documentation/devicetree/bindings/clock/clock-bindings.txt
- clock-names : Refer Documentation/devicetree/bindings/clock/clock-bindings.txt

Optional properties:
- h-pixels-fb-offset : Horizontal offset for framebuffer start.
- mode : Resolution definition.

Example:
	fb0: iris-dsi@fb0 {
		compatible = "socionext,f-iris-fb";
		reg = <0 0x37020000 0x8000>;
		interrupts = <0 212 0x4>,
			     <0 227 0x4>;
		id = <0>;
		simple = <0>;
		mode = "768x1280x32bpp";
		h-pixels-fb-offset = <12>;
		clocks = <&clk_dphy_1_0>, <&clk_main_1_3>, <&clk_main_3_3>;
		clock-names = "clk1", "clk2", "clk3";
	};
```

## linux/Documentation/devicetree/bindings/i2c/i2c-f_i2c.txt
```
* I2C

Required Properties :

 - reg : Offset and length of the register set for the device
 - compatible : "socionext,f_i2c"
 - interrupts : interrupt the I2C IP is connected to in the SoC
 - clock-frequency : I2C bus clock frequency in Hz (100000 or 400000)

Example :

	i2c: sn_i2c {
		compatible = "socionext,sn_i2c";
		reg = <0xfff73000 0x1000>;
		interrupts = <0 91 0x4>;
		clock-frequency = <100000>;
	};
```

## linux/Documentation/devicetree/bindings/net/socionext-ogma.txt
```
* Fujistu OGMA Ethernet Controller IP

Required properties:
- compatible: Should be "socionext,ogma"
- reg: Address and length of the register sets, the first is the main
	registers, then the rdlar and tdlar regions for the SoC
- interrupts: Should contain ethernet controller interrupt
- clocks: phandle to any clocks to be switched by runtime_pm
- phy-mode: See ethernet.txt file in the same directory
- max-speed: See ethernet.txt file in the same directory
- max-frame-size: See ethernet.txt file in the same directory, if 9000 or
	above jumbo frames are enabled
- local-mac-address: See ethernet.txt file in the same directory
- phy-handle: phandle to select child phy

For the child phy

- compatible "ethernet-phy-ieee802.3-c22" is needed
- device_type "ethernet-phy"
- reg: phy address


Example:
	eth0: f_taiki {
                compatible = "socionext,ogma";
		reg = <0 0x31600000 0x10000>, <0 0x31618000 0x4000>, <0 0x3161c000 0x4000>;
		interrupts = <0 163 0x4>;
		clocks = <&clk_alw_0_8>;
		phy-mode = "rgmii";
		max-speed = <1000>;
		max-frame-size = <9000>;
		local-mac-address = [ a4 17 31 00 00 ed ];
		phy-handle = <&ethphy0>;

		#address-cells = <1>;
		#size-cells = <0>;

		ethphy0: ethernet-phy@1 {
			device_type = "ethernet-phy";
			compatible = "ethernet-phy-ieee802.3-c22";
			reg = <1>;
		};
	};
```

## linux/Documentation/devicetree/bindings/pwm/pwm-mlb01.txt
```
Socionext mlb01 PWM controller

Required properties:
 - compatible: should be "socionext,mlb01-pwm"
 - reg: physical base address and length of the controller's registers.
	The first one is the apb registers and the second is the DMA area
	used for motor control / sequencer mode.
 - clocks: phandle and clock specifier of the PWM reference clock
 - #pwm-cells: must be 3. See pwm.txt in this directory
   for a description of the cell format.

Optional properties:
 - base-rate: set the rate of the clock to this at probe

Example:
        pwm0: pwm@1e120000 {
                compatible = "socionext,mlb01-pwm";
                reg = <0x1e001000 0x400>, <0x1e120000 0x10000>;
                clocks = <&rclk>;
                /* all the pwm units share the same clock */
                base-rate = <13500000>; /* ask for this input rate */
                #pwm-cells = <3>;
        };
```

## linux/Documentation/devicetree/bindings/video/socionext-display.txt
```
* Socionext Display

There are 2 display interface in phoenix platform.

Required properties:
- compatible : one of:
	"socionext,f_mipidsi1_lp"
	"socionext,f_hdmi_tx14"
- reg : Address and length of the register memory map.
- interrupts : irq number for this device.
- sources: bitfield of fbs can be driven by.
- clocks : Refer Documentation/devicetree/bindings/clock/clock-bindings.txt
- clock-names : Refer Documentation/devicetree/bindings/clock/clock-bindings.txt

Optional properties:

Example:
	videophy0: mipidsi@fb0 {
		compatible = "socionext,f_mipidsi1_lp";
		reg = <0 0x37700000 0x8000>;
		interrupts = <0 305 0x4>;
		sources = <1>;
		clocks = <&clk_dphy_0_0>, <&clk_dphy_1_0>, <&clk_main_5_3>;
		clock-names = "pllclk", "dpiclk", "pclk";
	};
```

## linux/arch/arm/configs/m8m_p1_defconfig
```kconfig
# CONFIG_LOCALVERSION_AUTO is not set
CONFIG_DEFAULT_HOSTNAME="m8mel"
CONFIG_SYSVIPC=y
CONFIG_POSIX_MQUEUE=y
CONFIG_FHANDLE=y
CONFIG_NO_HZ_FULL=y
CONFIG_NO_HZ_FULL_ALL=y
CONFIG_NO_HZ_FULL_SYSIDLE=y
CONFIG_NO_HZ_FULL_SYSIDLE_SMALL=4
CONFIG_HIGH_RES_TIMERS=y
CONFIG_BSD_PROCESS_ACCT=y
CONFIG_BSD_PROCESS_ACCT_V3=y
CONFIG_TASKSTATS=y
CONFIG_TASK_DELAY_ACCT=y
CONFIG_TASK_XACCT=y
CONFIG_TASK_IO_ACCOUNTING=y
CONFIG_IKCONFIG=y
CONFIG_IKCONFIG_PROC=y
CONFIG_CGROUPS=y
CONFIG_CGROUP_DEBUG=y
CONFIG_CPUSETS=y
CONFIG_CGROUP_SCHED=y
CONFIG_CFS_BANDWIDTH=y
CONFIG_RT_GROUP_SCHED=y
CONFIG_NAMESPACES=y
CONFIG_USER_NS=y
CONFIG_BLK_DEV_INITRD=y
CONFIG_CC_OPTIMIZE_FOR_SIZE=y
CONFIG_KALLSYMS_ALL=y
CONFIG_EMBEDDED=y
# CONFIG_COMPAT_BRK is not set
CONFIG_SLAB=y
CONFIG_PROFILING=y
CONFIG_OPROFILE=m
CONFIG_MODULES=y
CONFIG_MODULE_UNLOAD=y
CONFIG_ARCH_M8M=y
CONFIG_ARM_ERRATA_754322=y
CONFIG_ARM_ERRATA_775420=y
CONFIG_PCI=y
CONFIG_PCI_DEBUG=y
CONFIG_PCI_HOST_GENERIC=y
CONFIG_SMP=y
# CONFIG_ARM_CPU_TOPOLOGY is not set
CONFIG_HAVE_ARM_ARCH_TIMER=y
CONFIG_VMSPLIT_2G=y
CONFIG_PREEMPT=y
CONFIG_THUMB2_KERNEL=y
CONFIG_HIGHMEM=y
# CONFIG_COMPACTION is not set
CONFIG_CMA=y
# CONFIG_ATAGS is not set
CONFIG_ZBOOT_ROM_TEXT=0x0
CONFIG_ZBOOT_ROM_BSS=0x0
CONFIG_ARM_APPENDED_DTB=y
CONFIG_KEXEC=y
CONFIG_CPU_FREQ=y
CONFIG_CPU_FREQ_DEFAULT_GOV_ONDEMAND=y
CONFIG_CPUFREQ_DT=y
CONFIG_CPU_IDLE=y
CONFIG_PM_RUNTIME=y
CONFIG_PM_DEBUG=y
CONFIG_WQ_POWER_EFFICIENT_DEFAULT=y
CONFIG_NET=y
CONFIG_PACKET=y
CONFIG_PACKET_DIAG=m
CONFIG_UNIX=y
CONFIG_INET=y
CONFIG_IP_MULTICAST=y
CONFIG_IP_MROUTE=y
CONFIG_IP_PIMSM_V1=y
CONFIG_IP_PIMSM_V2=y
CONFIG_SYN_COOKIES=y
CONFIG_NET_IPVTI=m
CONFIG_INET_AH=y
CONFIG_INET_ESP=y
CONFIG_INET_IPCOMP=y
CONFIG_INET_XFRM_MODE_TRANSPORT=m
CONFIG_INET_XFRM_MODE_TUNNEL=m
CONFIG_INET_XFRM_MODE_BEET=m
CONFIG_INET_UDP_DIAG=y
CONFIG_TCP_CONG_ADVANCED=y
#CONFIG_IPV6=y
CONFIG_IP_SCTP=y
CONFIG_SCTP_COOKIE_HMAC_SHA1=y
CONFIG_TIPC=y
CONFIG_L2TP=m
CONFIG_L2TP_DEBUGFS=m
CONFIG_L2TP_V3=y
CONFIG_L2TP_IP=y
CONFIG_L2TP_ETH=y
CONFIG_IPX=m
CONFIG_NETLINK_MMAP=y
CONFIG_NETLINK_DIAG=y
#CONFIG_BT=y
#CONFIG_BT_RFCOMM=y
#CONFIG_BT_RFCOMM_TTY=y
#CONFIG_BT_BNEP=y
#CONFIG_BT_BNEP_MC_FILTER=y
#CONFIG_BT_HIDP=y
#CONFIG_BT_HCIBTUSB=y
#CONFIG_BT_HCIBTSDIO=y
#CONFIG_BT_MRVL=m
#CONFIG_BT_MRVL_SDIO=m
CONFIG_CFG80211=y
CONFIG_NL80211_TESTMODE=y
CONFIG_CFG80211_DEVELOPER_WARNINGS=y
CONFIG_CFG80211_REG_DEBUG=y
CONFIG_CFG80211_INTERNAL_REGDB=y
CONFIG_CFG80211_WEXT=y
CONFIG_MAC80211=y
# CONFIG_MAC80211_RC_MINSTREL is not set
CONFIG_MAC80211_LEDS=y
CONFIG_RFKILL=y
CONFIG_RFKILL_INPUT=y
CONFIG_RFKILL_REGULATOR=y
CONFIG_DEVTMPFS=y
CONFIG_DEVTMPFS_MOUNT=y
CONFIG_DMA_CMA=y
CONFIG_CMA_SIZE_MBYTES=64
CONFIG_MTD=y
CONFIG_MTD_BLOCK=y
CONFIG_MTD_M25P80=y
CONFIG_MTD_NAND=y
CONFIG_MTD_NAND_DENALI=y
CONFIG_MTD_NAND_DENALI_DT=y
CONFIG_MTD_NAND_PLATFORM=y
CONFIG_MTD_SPI_NOR=y
CONFIG_MTD_UBI=y
CONFIG_MTD_UBI_BEB_LIMIT=3
CONFIG_BLK_DEV_LOOP=y
CONFIG_BLK_DEV_LOOP_MIN_COUNT=2
CONFIG_BLK_DEV_RAM=y
CONFIG_SCSI=y
CONFIG_BLK_DEV_SD=y
CONFIG_NETDEVICES=y
CONFIG_MACVLAN=y
CONFIG_TUN=y
CONFIG_VETH=y
# CONFIG_NET_CADENCE is not set
# CONFIG_NET_VENDOR_BROADCOM is not set
# CONFIG_NET_VENDOR_CIRRUS is not set
# CONFIG_NET_VENDOR_FARADAY is not set
# CONFIG_NET_VENDOR_INTEL is not set
# CONFIG_NET_VENDOR_MARVELL is not set
# CONFIG_NET_VENDOR_MICREL is not set
# CONFIG_NET_VENDOR_NATSEMI is not set
CONFIG_R8169=y
# CONFIG_NET_VENDOR_SEEQ is not set
# CONFIG_NET_VENDOR_SMSC is not set
CONFIG_NET_SOCIONEXT_OGMA=y
# CONFIG_NET_VENDOR_STMICRO is not set
# CONFIG_NET_VENDOR_WIZNET is not set
CONFIG_REALTEK_PHY=y
CONFIG_MWIFIEX=m
CONFIG_MWIFIEX_SDIO=m
# CONFIG_INPUT_MOUSEDEV is not set
CONFIG_INPUT_EVDEV=y
#CONFIG_KEYBOARD_GPIO=y
#CONFIG_KEYBOARD_GPIO_POLLED=y
# CONFIG_INPUT_MOUSE is not set
CONFIG_LEGACY_PTY_COUNT=4
# CONFIG_DEVKMEM is not set
CONFIG_SERIAL_8250=y
# CONFIG_SERIAL_8250_DEPRECATED_OPTIONS is not set
CONFIG_SERIAL_8250_CONSOLE=y
# CONFIG_SERIAL_8250_DMA is not set
CONFIG_SERIAL_8250_EXTENDED=y
CONFIG_SERIAL_8250_DW=y
CONFIG_SERIAL_OF_PLATFORM=y
CONFIG_SERIAL_SN_USIO_CONSOLE=y
# CONFIG_HW_RANDOM is not set
CONFIG_I2C_SN_I2C=y
CONFIG_SPI=y
CONFIG_SPI_SN_USIO=y
CONFIG_GPIOLIB=y
CONFIG_GPIO_SYSFS=y
CONFIG_GPIO_PCA953X=y
CONFIG_GPIO_PCA953X_IRQ=y
# CONFIG_HWMON is not set
CONFIG_WATCHDOG=y
CONFIG_SOFT_WATCHDOG=m
CONFIG_REGULATOR=y
CONFIG_REGULATOR_DEBUG=y
CONFIG_REGULATOR_S6AP412=y
CONFIG_MEDIA_SUPPORT=y
CONFIG_MEDIA_CAMERA_SUPPORT=y
CONFIG_MEDIA_CONTROLLER=y
#CONFIG_VIDEO_V4L2_SUBDEV_API=y
#CONFIG_VIDEO_ADV_DEBUG=y
CONFIG_MEDIA_USB_SUPPORT=y
CONFIG_USB_VIDEO_CLASS=y
# CONFIG_USB_GSPCA is not set
#CONFIG_V4L_PLATFORM_DRIVERS=y
CONFIG_SOC_CAMERA=y
CONFIG_SOC_CAMERA_PLATFORM=y
CONFIG_V4L_MEM2MEM_DRIVERS=y
CONFIG_DRM=y
CONFIG_DRM_SOCIONEXT_FDB=y
CONFIG_FB=y
CONFIG_FB_SOCIONEXT_FDB=y
CONFIG_FDB_HDMITX14=y
CONFIG_FB_FDB_DISP8M=y
#CONFIG_BACKLIGHT_LCD_SUPPORT=y
#CONFIG_LCD_CLASS_DEVICE=y
#CONFIG_LCD_COM3OT38391=y
#CONFIG_BACKLIGHT_CLASS_DEVICE=y
#CONFIG_BACKLIGHT_GPIO=y
CONFIG_FRAMEBUFFER_CONSOLE=y
CONFIG_FRAMEBUFFER_CONSOLE_DETECT_PRIMARY=y
#CONFIG_LOGO=y
#CONFIG_SOUND=y
#CONFIG_SND=y
#CONFIG_SND_SOC=y
#CONFIG_SND_SOC_MB86S27_AK4642=y
#CONFIG_SND_SOC_MB86S70_HDMI=y
#CONFIG_SND_I2S_JMILAU8M=y
CONFIG_USB=y
CONFIG_USB_ANNOUNCE_NEW_DEVICES=y
CONFIG_USB_MON=m
CONFIG_USB_XHCI_HCD=y
CONFIG_USB_F_USB20HDC=y
CONFIG_USB_F_USB20HDC_GADGET_ONLY=y
CONFIG_USB_STORAGE=y
CONFIG_USB_SERIAL=m
CONFIG_USB_SERIAL_GENERIC=y
CONFIG_USB_SERIAL_CP210X=m
CONFIG_USB_SERIAL_FTDI_SIO=m
CONFIG_USB_SERIAL_PL2303=m
CONFIG_USB_ULPI=y
CONFIG_USB_GADGET=y
CONFIG_USB_CONFIGFS=y
CONFIG_USB_CONFIGFS_ACM=y
CONFIG_USB_CONFIGFS_MASS_STORAGE=y
CONFIG_USB_CONFIGFS_F_MTP=y
CONFIG_USB_CONFIGFS_UEVENT=y
CONFIG_MMC=y
CONFIG_MMC_SDHCI=y
CONFIG_MMC_SDHCI_PLTFM=y
CONFIG_MMC_SDHCI_F_SDH30=y
CONFIG_NEW_LEDS=y
CONFIG_LEDS_CLASS=y
CONFIG_LEDS_GPIO=y
CONFIG_LEDS_TRIGGER_TIMER=y
CONFIG_LEDS_TRIGGER_HEARTBEAT=y
CONFIG_RTC_CLASS=y
# CONFIG_RTC_HCTOSYS is not set
# CONFIG_RTC_SYSTOHC is not set
CONFIG_RTC_DEBUG=y
CONFIG_RTC_DRV_RX8025=y
CONFIG_DMADEVICES=y
CONFIG_MB86S7X_HDMAC=y
CONFIG_MB8AC0300_XDMAC=y
CONFIG_SNI_IPCU=y
# CONFIG_IOMMU_SUPPORT is not set
CONFIG_PWM=y
CONFIG_PWM_MLB01=y
CONFIG_RESET_CONTROLLER=y
CONFIG_EXFAT=y
CONFIG_EXT4_FS=y
# CONFIG_EXT4_USE_FOR_EXT23 is not set
CONFIG_XFS_FS=y
CONFIG_XFS_QUOTA=y
CONFIG_XFS_POSIX_ACL=y
CONFIG_XFS_RT=y
CONFIG_XFS_WARN=y
CONFIG_FANOTIFY=y
CONFIG_FANOTIFY_ACCESS_PERMISSIONS=y
CONFIG_QUOTA=y
CONFIG_AUTOFS4_FS=y
CONFIG_FUSE_FS=y
CONFIG_FSCACHE=y
CONFIG_FSCACHE_STATS=y
CONFIG_FSCACHE_HISTOGRAM=y
CONFIG_MSDOS_FS=y
CONFIG_VFAT_FS=y
CONFIG_FAT_DEFAULT_CODEPAGE=932
CONFIG_TMPFS=y
CONFIG_TMPFS_POSIX_ACL=y
CONFIG_UBIFS_FS=y
CONFIG_UBIFS_FS_ADVANCED_COMPR=y
CONFIG_ROMFS_FS=y
CONFIG_ROMFS_BACKED_BY_BOTH=y
CONFIG_NFS_FS=m
CONFIG_NLS_CODEPAGE_437=y
CONFIG_NLS_CODEPAGE_932=y
CONFIG_NLS_ISO8859_1=y
CONFIG_NLS_UTF8=y
# CONFIG_TEST_IPCU_FS is not set
CONFIG_IPCU_FS=y
CONFIG_PRINTK_TIME=y
CONFIG_DEBUG_INFO=y
CONFIG_DEBUG_INFO_REDUCED=y
CONFIG_DEBUG_FS=y
CONFIG_HEADERS_CHECK=y
CONFIG_DEBUG_SECTION_MISMATCH=y
CONFIG_DEBUG_MEMORY_INIT=y
# CONFIG_DEBUG_PREEMPT is not set
CONFIG_RCU_TORTURE_TEST=m
CONFIG_RCU_CPU_STALL_TIMEOUT=60
CONFIG_KGDB=y
CONFIG_DEBUG_USER=y
CONFIG_KEYS=y
CONFIG_ENCRYPTED_KEYS=y
CONFIG_SECURITY=y
# CONFIG_CRYPTO_ANSI_CPRNG is not set
# CONFIG_CRYPTO_HW is not set
#CONFIG_FONTS=y
```
