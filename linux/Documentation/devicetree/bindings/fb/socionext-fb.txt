## linux/drivers/usb/socionext_drc/Kconfig
```kconfig
#
# Socionext USB2.0 Dual-Role Controller Drivers
#

config USB_F_USB20HDC
	tristate 'Socionext USB 2.0 Dual Role controller'
	depends on USB && (ARCH_MB8AC0300 || ARCH_MB86S70 || ARCH_MILBEAUT)
	default n
	help
	  f_usb20hdc is a dual-role USB controller chip.
	  that supports both full and high speed USB 2.0 data transfers.
	  It has nine or more configurable endpoints, and endpoint zero.

	  Say "y" to link the driver statically, or "m" to build a
	  dynamically linked module called "f_usb20hdc_drc.ko"


if USB_F_USB20HDC

choice
	bool "F_USB20HDC Mode Selection"
	default USB_F_USB20HDC_DUAL_ROLE if (USB && USB_GADGET)
	default USB_F_USB20HDC_HOST_ONLY if (USB && !USB_GADGET)
	default USB_F_USB20HDC_GADGET_ONLY if (!USB && USB_GADGET)

config USB_F_USB20HDC_HOST_ONLY
	bool "Host only mode"
	depends on USB=y || USB=USB_F_USB20HDC
	help
	  Select this when you want to use F_USB20HDC in
	  host mode only, thereby the gadget feature will
	  be regressed. also gadget code will not be included
	  in this kernel module.

config USB_F_USB20HDC_GADGET_ONLY
	bool "Gadget only mode"
	depends on USB_GADGET=y || USB_GADGET=USB_F_USB20HDC
	select USB_GADGET_DUALSPEED
	select USB_GADGET_SELECTED
	help
	  Select this when you want to use F_USB20HDC in
	  gadget mode only, thereby the host feature will be regressed.
	  also host mode code will not be included in this kernel
	  module.

config USB_F_USB20HDC_DUAL_ROLE
	bool "Dual Role mode"
	depends on ((USB=y || USB=USB_F_USB20HDC) && (USB_GADGET=y || USB_GADGET=USB_F_USB20HDC))
	select USB_GADGET_DUALSPEED
	select USB_GADGET_SELECTED
	help
	  This is the default mode of working of F_USB20HDC controller where
	  both host and gadget features are enabled.
	  when this mode is selected, dtb also can interfere dynamic decision
	  to choose host mode only, gadget mode only, or dual mode. but either
	  of these mode still included all mode function code.

endchoice

config USB_F_USB20HDC_USED_DMA_TRANSFER
        bool "Use DMA transfer"
        depends on USB_F_USB20HDC
        default y
        help
          This turns on dma transfer for F_USB20HDC USB
          Controller driver in both host mode and device mode
          If you want to use a DMA transfer, say Y here.
          If unsure, say 'y'.

endif
```

## linux/drivers/video/fbdev/socionext/Kconfig
```kconfig
config FDB_HDMITX14
	tristate "Socionext HDMI 1.4 Head support"
	depends on FB
	help
	  This supports the HDMI 1.4 Video Output head found on MB86S70

config FB_FDB_DISP8M
	tristate "Socionext M8M DISP 2D Graphics Unit"
	depends on FB
	select FB_CFB_FILLRECT
	select FB_CFB_COPYAREA
	select FB_CFB_IMAGEBLIT
	help
	  Select 'y' or 'm' to build framebuffer support for
	  Socionext DISP graphics unit which is used in, eg,
	  Socionext mb86s27 SoC
```

## linux/sound/soc/m8m/Kconfig
```kconfig
config SND_I2S_JMILAU8M
	tristate "Socionext m8m i2s support"
	depends on RESET_CONTROLLER
	help
	  This is the driver for the I2S IP in Fujitsu
	  m8m series ASICs
```

## linux/sound/soc/mb8ac0300/Kconfig
```kconfig
config SND_MB8AC0300_PCM
	tristate "Socionext pcm driver"
	depends on MB86S7X_HDMAC
	help
	  This is the driver for the pcm DMA operations
	  in Socionext mb8 series ASICs

config SND_SOC_MB86S27_AK4642
	tristate "SoC Audio support for MB86S27 + AK4642 codec"
	depends on I2C
	select SND_SOC_AK4642
	select SND_MB8AC0300_PCM
	help
	  Say Y or M here if you want to
	  add support for SoC audio on
	  MB86S70 boards using
	  WM8973 codec.

config SND_SOC_MB86S70_HDMI
        tristate "SoC Audio support for MB86S70 HDMI"
        depends on ARCH_MB86S70 || ARCH_MILBEAUT
        select SND_SOC_MB86S70_HDMI_DAI
        select SND_SOC_MB86S70_HDMI_CODEC
	select SND_MB8AC0300_PCM
        help
          Say Y if you want to add support for SoC HDMI audio on MB86S70 chips.

config SND_SOC_MB86S70_HDMI_DAI
        tristate
```
